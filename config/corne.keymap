#include "../miryoku/custom_config.h"
#include "../miryoku/mapping/42/corne.h"

/* Corne 3x5+3 Fast Base: ordinary alpha/punctuation keys on BASE.
 * Keep EXTRA as the original QWERTY home-row-mod layout.
 * Six thumb layer-taps and all other Miryoku layers remain unchanged.
 * Define BASE before including miryoku.dtsi / layer_selection.h.
 */
#define MIRYOKU_LAYER_BASE \
&kp Q, &kp W, &kp E, &kp R, &kp T,     &kp Y, &kp U, &kp I, &kp O, &kp P, \
&kp A, &kp S, &kp D, &kp F, &kp G,     &kp H, &kp J, &kp K, &kp L, &kp SQT, \
&kp Z, &kp X, &kp C, &kp V, &kp B,     &kp N, &kp M, &kp COMMA, &kp DOT, &kp SLASH, \
U_NP, U_NP, U_LT(U_MEDIA, ESC), U_LT(U_NAV, SPACE), U_LT(U_MOUSE, TAB), U_LT(U_SYM, RET), U_LT(U_NUM, BSPC), U_LT(U_FUN, DEL), U_NP, U_NP

#include "../miryoku/miryoku.dtsi"

/* Home-row modifiers remain available on EXTRA. */
&u_mt {
    tapping-term-ms = <200>;
    flavor = "tap-preferred";
    require-prior-idle-ms = <175>;
    quick-tap-ms = <175>;
};

/* Preserve thumb layer-tap and matrix debounce tuning. */
&u_lt {
    tapping-term-ms = <180>;
    flavor = "hold-preferred";
};

&kscan0 {
    debounce-press-ms = <1>;
    debounce-release-ms = <5>;
};
